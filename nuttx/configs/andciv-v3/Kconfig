## nuttx/configs/andciv-v3/Kconfig
```kconfig
#
# For a description of the syntax of this configuration file,
# see misc/tools/kconfig-language.txt.
#

if ARCH_BOARD_ANDCIV_V3

config ANDCIV_INIT_SP
	bool "Initialize stack pointer after reset"
	default y
	depends on !ARMV7M_CMNVECTOR

endif
```
